## zobo_esp32/sdkconfig.defaults
```kconfig
# Zobo ESP32 BLE Robot Controller - Default Configuration

# ============================================================================
# Flash Configuration
# ============================================================================
CONFIG_ESPTOOLPY_FLASHSIZE_4MB=y
CONFIG_ESPTOOLPY_FLASHSIZE="4MB"

# ============================================================================
# Partition Table (OTA support)
# ============================================================================
CONFIG_PARTITION_TABLE_CUSTOM=y
CONFIG_PARTITION_TABLE_CUSTOM_FILENAME="partitions.csv"
CONFIG_PARTITION_TABLE_FILENAME="partitions.csv"

# ============================================================================
# Bluetooth Configuration
# ============================================================================
CONFIG_BT_ENABLED=y
CONFIG_BT_BLUEDROID_ENABLED=y
CONFIG_BT_CLASSIC_ENABLED=n
CONFIG_BT_BLE_ENABLED=y
CONFIG_BT_BLE_42_FEATURES_SUPPORTED=y
CONFIG_BTDM_CTRL_MODE_BLE_ONLY=y
CONFIG_BTDM_CTRL_MODE_BR_EDR_ONLY=n
CONFIG_BTDM_CTRL_MODE_BTDM=n
CONFIG_BT_GATTS_ENABLE=y
CONFIG_BT_GATTC_ENABLE=n
CONFIG_BT_DEVICE_NAME="Zobo"

# ============================================================================
# WiFi Configuration
# ============================================================================
CONFIG_ESP_WIFI_ENABLED=y
CONFIG_ESP_WIFI_STATIC_RX_BUFFER_NUM=10
CONFIG_ESP_WIFI_DYNAMIC_RX_BUFFER_NUM=32
CONFIG_ESP_WIFI_DYNAMIC_TX_BUFFER_NUM=32

# ============================================================================
# WiFi/BLE Coexistence
# ============================================================================
CONFIG_SW_COEXIST_ENABLE=y
CONFIG_ESP_COEX_SW_COEXIST_ENABLE=y
CONFIG_BTDM_CTRL_COEX_PHY_CODED_TX_RX_TLIM_DIS=y
CONFIG_BTDM_CTRL_HCI_MODE_VHCI=y
CONFIG_BTDM_CTRL_BLE_MAX_CONN=1
CONFIG_BTDM_CTRL_BR_EDR_MAX_ACL_CONN=0
CONFIG_BTDM_CTRL_BR_EDR_MAX_SYNC_CONN=0
CONFIG_ESP_WIFI_SW_COEXIST_ENABLE=y

# ============================================================================
# HTTP Client (for OTA)
# ============================================================================
CONFIG_ESP_HTTP_CLIENT_ENABLE_HTTPS=y
CONFIG_ESP_HTTP_CLIENT_ENABLE_BASIC_AUTH=n

# ============================================================================
# OTA Configuration
# ============================================================================
CONFIG_BOOTLOADER_APP_ROLLBACK_ENABLE=y
CONFIG_ESP_HTTPS_OTA_ALLOW_HTTP=y

# ============================================================================
# PWM (LEDC) Configuration
# ============================================================================
CONFIG_LEDC_FADE_FUNCTION_WITH_ISR=y

# ============================================================================
# ESP32 specific
# ============================================================================
CONFIG_ESP_DEFAULT_CPU_FREQ_MHZ_240=y
CONFIG_ESP_DEFAULT_CPU_FREQ_MHZ=240

# ============================================================================
# Log level
# ============================================================================
CONFIG_LOG_DEFAULT_LEVEL_INFO=y
CONFIG_LOG_DEFAULT_LEVEL=3

# ============================================================================
# NVS (for WiFi credentials storage)
# ============================================================================
CONFIG_NVS_ENCRYPTION=n
```
